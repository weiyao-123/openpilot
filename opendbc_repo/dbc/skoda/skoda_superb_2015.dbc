VERSION ""

NS_ :

BS_:

BU_: GATEWAY EPS ABS

BO_ 100 STEERING_ANGLE: 8 GATEWAY
 SG_ STEER_ANGLE : 0|16@1+ (0.1,0) [0|360] "" EPS

BO_ 200 BRAKE_STATUS: 3 ABS
 SG_ BRAKE_PRESSED : 0|1@1+ (1,0) [0|1] "" ABS
